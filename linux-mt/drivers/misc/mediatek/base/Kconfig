## linux-mt/drivers/misc/mediatek/base/Kconfig
```kconfig
config MTK_BASE_POWER
    bool "MTK_BASE_POWER"
    help
      Enable MTK Power Feature

config MTK_BASE_POWER_MT7622
    bool "MTK_BASE_POWER_MT7622"
    help
      Enable MTK Power Feature for MT7622
```

## phoenix/system/src/drivers/wifi/rtl8814ae/Kconfig
```kconfig
config RTL8814AE
	tristate "Realtek 8814A PCI WiFi"
	depends on PCI
	---help---
	  Help message of RTL8814AE
```
